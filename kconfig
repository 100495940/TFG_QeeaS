## kconfig
```kconfig
menu "Configuración Wi-Fi del TFG"

config WIFI_MI_SSID
    string "Nombre de la red Wi-Fi (SSID)"
    default "MI_RED_WIFI"
    help
      El nombre de la red a la que se conectara la ESP32-C6.

config WIFI_MI_PASSWORD
    string "Contraseña de la red Wi-Fi"
    default "MI_CONTRASENA"
    help
      La contraseña WPA2 de la red.

endmenu

menu "Configuración Zenoh del TFG"

config ZENOH_ENDPOINT
    string "Dirección IP del router de zenoh"
    default "tcp/192.168.1.1:7447"
    help
      La dirección IP del router de zenoh al que se conectará la ESP32-C6.

config QEAAS_TLS_CA_BASE64
    string "CA TLS del router Zenoh codificada en Base64"
    default ""
    help
      Certificado de la CA local en Base64. Se utiliza para que la ESP32-C6
      pueda validar el certificado presentado por el router Zenoh cuando se
      emplea un endpoint tls/IP:puerto.

endmenu

config ENTROPY_RAW_MODE
    bool "Modo binario crudo para tests del NIST"
    default n
    help
      Si se activa (y), la placa enviará datos binarios puros
      Si se desactiva (n), enviara texto en formato DEBUG

# Esta linea es obligatoria para cargar el resto del SO
source "Kconfig.zephyr"
```
